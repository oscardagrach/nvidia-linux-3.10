/*
 * arch/arm/boot/dts/tegra124-platforms/tegra124-bthrot-cdev.dtsi
 *
 * Copyright (c) 2014, NVIDIA CORPORATION.  All rights reserved.
 *
 * This program is free software; you can redistribute it and/or modify
 * it under the terms of the GNU General Public License as published by
 * the Free Software Foundation; version 2 of the License.
 *
 * This program is distributed in the hope that it will be useful, but WITHOUT
 * ANY WARRANTY; without even the implied warranty of MERCHANTABILITY or
 * FITNESS FOR A PARTICULAR PURPOSE.  See the GNU General Public License for
 * more details.
 *
 * You should have received a copy of the GNU General Public License along
 * with this program; if not, write to the Free Software Foundation, Inc.,
 * 51 Franklin Street, Fifth Floor, Boston, MA  02110-1301, USA.
 *
 */

/{
	bthrot_cdev {
		compatible = "nvidia,balanced-throttle";
		cpu_balanced {
			cdev-type = "cpu-balanced";
			num_states = <55>;
			cooling-min-state = <0>;
			cooling-max-state = <55>;
			#cooling-cells = <2>;
			status = "disabled";
			throttle_table = <
				/*CPU		C2BUS		C3BUS		SCLK		EMC	*/
				1810500		4294967295	4294967295	4294967295	4294967295
				1785000		4294967295	4294967295	4294967295	4294967295
				1759500		4294967295	4294967295	4294967295	4294967295
				1734000		4294967295	4294967295	4294967295	4294967295
				1708500		4294967295	4294967295	4294967295	4294967295
				1683000		4294967295	4294967295	4294967295	4294967295
				1657500		4294967295	4294967295	4294967295	4294967295
				1632000		4294967295	4294967295	4294967295	4294967295
				1606500		4294967295	4294967295	4294967295	4294967295
				1581000		4294967295	4294967295	4294967295	4294967295
				1555500		4294967295	4294967295	4294967295	4294967295
				1530000		4294967295	4294967295	4294967295	4294967295
				1504500		4294967295	4294967295	4294967295	4294967295
				1479000		4294967295	4294967295	4294967295	4294967295
				1453500		4294967295	4294967295	4294967295	4294967295
				1428000		4294967295	4294967295	4294967295	4294967295
				1402500		4294967295	4294967295	4294967295	4294967295
				1377000		4294967295	4294967295	4294967295	4294967295
				1351500		4294967295	4294967295	4294967295	4294967295
				1326000		4294967295	4294967295	4294967295	4294967295
				1300500		4294967295	4294967295	4294967295	4294967295
				1275000		4294967295	4294967295	4294967295	4294967295
				1249500		4294967295	4294967295	4294967295	4294967295
				1224000		4294967295	4294967295	4294967295	4294967295
				1198500		4294967295	4294967295	4294967295	4294967295
				1173000		636000		4294967295	4294967295	4294967295
				1147500		636000		4294967295	4294967295	4294967295
				1122000		636000		4294967295	4294967295	4294967295
				1096500		636000		4294967295	4294967295	4294967295
				1071000		636000		4294967295	4294967295	4294967295
				1045500		636000		4294967295	4294967295	4294967295
				1020000		636000		4294967295	4294967295	4294967295
				994500		636000		4294967295	4294967295	4294967295
				969000		600000		4294967295	4294967295	4294967295
				943500		600000		4294967295	4294967295	4294967295
				918000		600000		4294967295	4294967295	4294967295
				892500		600000		4294967295	4294967295	4294967295
				867000		600000		4294967295	4294967295	4294967295
				841500		564000		4294967295	4294967295	4294967295
				816000		564000		4294967295	4294967295	792000
				790500		564000		4294967295	372000		792000
				765000		564000		468000		372000		792000
				739500		528000		468000		372000		792000
				714000		528000		468000		336000		792000
				688500		528000		420000		336000		792000
				663000		492000		420000		336000		792000
				637500		492000		420000		336000		408000
				612000		492000		420000		300000		408000
				586500		492000		360000		336000		408000
				561000		420000		420000		300000		408000
				535500		420000		360000		228000		408000
				510000		420000		288000		228000		408000
				484500		324000		288000		228000		408000
				459000		324000		288000		228000		408000
				433500		324000		288000		228000		408000
				408000		324000		288000		228000		408000
			>;
		};
	};
};
